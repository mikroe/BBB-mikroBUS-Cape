/*
* Copyright (C) 2014 Written by Peter Szamosi <szamosi.peter@gmail.com> 
*
* This program is free software; you can redistribute it and/or modify
* it under the terms of the GNU General Public License version 2 as
* published by the Free Software Foundation.
*
*/
/dts-v1/;
/plugin/;

/ {
	/* identification */
	part-number = "BB-MIKROBUS-01";
	version = "00A1";

	/* state the resources this cape uses */
	exclusive-use =
	/* the pin header uses */
		“P9.12″, /* spi irq: gpio1_28 */
		“P9.15″, /* spi irq: gpio1_16 */
		“P9.31″, /* spi: spi1_sclk */
		“P9.29″, /* spi: spi1_d0 */
		“P9.30″, /* spi: spi1_d1 */
		“P9.28″, /* spi: spi1_cs0 */
		“P9.42″, /* spi: spi1_cs1 */
		“P9.21″, /* dcan1: dcan1_tx */
		“P9.22″, /* dcan1: dcan1_rx */
		/* the hardware IP uses */
		“gpio3_19″,
		“gpio1_17″,
		“spi1″,
		“dcan1″;

	fragment@0 {
		target = ;
		__overlay__ {

			bone_tt3201_dcan1_pins: bone_tt3201_dcan1_pins {
				pinctrl-single,pins = ;
			};

			bone_tt3201_spi1_pins: pinmux_bone_tt3201_spi1_pins {
				pinctrl-single,pins = ;
			};

			bone_tt3201_mcp2515_0_pins: pinmux_bone_tt3201_0_mcp2515_pins {
				pinctrl-single,pins = ;
			};

			bone_tt3201_mcp2515_1_pins: pinmux_bone_tt3201_1_mcp2515_pins {
				pinctrl-single,pins = ;
			};
		};
	};

	fragment@1 {
		target = ;
		__overlay__ {
			#address-cells = ;
			#size-cells = ;

			status = “okay”;
			pinctrl-names = “default”;
			pinctrl-0 = ;

			cs-gpios = , ;

			mcp2515@0 {

				compatible = “microchip,mcp2515″;
				reg = ; /* cs1 */
				mode = ;

				spi-max-frequency = ;

				pinctrl-names = “default”;
				pinctrl-0 = ;

				interrupt-parent = ;
				interrupts = ;

				mcp251x,oscillator-frequency = ;
				mcp251x,irq-gpios = ;
				mcp251x,stay-awake = ;
			};

			mcp2515@1 {

				compatible = “microchip,mcp2515″;
				reg = ; /* cs0 */
				mode = ;

				spi-max-frequency = ;

				pinctrl-names = “default”;
				pinctrl-0 = ;

				interrupt-parent = ;
				interrupts = ;

				mcp251x,oscillator-frequency = ;
				mcp251x,irq-gpios = ;
				mcp251x,stay-awake = ;
				mcp251x,enable-clkout = ;
			};
		};
	};

	fragment@2 {
		target = ;
		__overlay__ {
			status = “okay”;
			pinctrl-names = “default”;
			pinctrl-0 = ;
		};
	};
};